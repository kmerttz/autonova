## src/modules/edu_module/Kconfig
```kconfig
menuconfig MODULES_EDU_MODULE
	bool "edu_module"
	default n
	---help---
		Enable support for edu_module
```

## src/modules/nova_intercept/Kconfig
```kconfig
menuconfig MODULES_NOVA_INTERCEPT
	bool "nova_intercept"
	default y
	---help---
		Enable support for intercept
```

## src/modules/nova_kamikaze/Kconfig
```kconfig
menuconfig MODULES_NOVA_KAMIKAZE
	bool "nova_kamikaze"
	default y
	---help---
		Enable support for kamikaze
```

## src/modules/nova_kamikaze_apr/Kconfig
```kconfig
menuconfig MODULES_NOVA_KAMIKAZE_APR
	bool "nova_kamikaze_apr"
	default y
	---help---
		Enable support for kamikaze approach
```

## src/modules/nova_test_cmd/Kconfig
```kconfig
menuconfig MODULES_NOVA_TEST_CMD
	bool "nova_test_cmd"
	default n
	---help---
		Vehicle command tests to see the results.
```

## src/modules/vehicle_info_sender/Kconfig
```kconfig
menuconfig MODULES_VEHICLE_INFO_SENDER
	bool "vehicle_info_sender"
	default y
	---help---
		Enable support for vehicle_info_sender
```
